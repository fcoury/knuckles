## hardware/integrated-controller/firmware/Kconfig
```kconfig
menu "Knuckles integrated controller"
if BOARD_KNUCKLES_INTEGRATED
config KNUCKLES_BATTERY_VERIFIED
    bool "Enable charging for an electrically verified cell and thermistor"
    default n
    help
      Requires a protected 4.2 V cell rated for the selected current and a
      10k beta-3435 thermistor bonded to the cell. R12 must also be fitted.
      Keep disabled during initial bring-up.
choice KNUCKLES_BATTERY_PROFILE
    prompt "Battery charging profile"
    default KNUCKLES_BATTERY_110
config KNUCKLES_BATTERY_110
    bool "110 mAh / 20 mA"
config KNUCKLES_BATTERY_250
    bool "250 mAh / 50 mA"
config KNUCKLES_BATTERY_500
    bool "500 mAh / 100 mA"
endchoice
endif
endmenu
```

## hardware/integrated-controller/firmware/boards/arm/knuckles_integrated/Kconfig.board
```kconfig
config BOARD_KNUCKLES_INTEGRATED
    bool "Knuckles integrated nRF52840"
    depends on SOC_NRF52840_QIAA
```

## hardware/integrated-controller/firmware/boards/arm/knuckles_integrated/Kconfig.defconfig
```kconfig
if BOARD_KNUCKLES_INTEGRATED
config BOARD
    default "knuckles_integrated"
config USB_NRFX
    default y if USB_DEVICE_STACK
config BT_CTLR
    default BT
config SOC_DCDC_NRF52X
    default y
config SOC_DCDC_NRF52X_HV
    default n
config USB_MAX_POWER
    default 125
endif
```

## hardware/integrated-controller/firmware/config/boards/shields/knuckles/Kconfig.shield
```kconfig
config SHIELD_KNUCKLES_LEFT
    def_bool $(shields_list_contains,knuckles_left)

config SHIELD_KNUCKLES_RIGHT
    def_bool $(shields_list_contains,knuckles_right)
```

## hardware/integrated-controller/firmware/config/boards/shields/knuckles_tps43/Kconfig.defconfig
```kconfig
if SHIELD_KNUCKLES_TPS43_LEFT

config ZMK_KEYBOARD_NAME
	default "Knuckles TPS43"

endif

if SHIELD_KNUCKLES_TPS43_LEFT || SHIELD_KNUCKLES_TPS43_RIGHT

config ZMK_SPLIT
	default y

endif

if SHIELD_KNUCKLES_TPS43_RIGHT

config ZMK_KEYBOARD_NAME
	default "Knuckles TPS43"

config ZMK_SPLIT_ROLE_CENTRAL
	default y

config ZMK_POINTING
	default y

config INPUT
	default y

config INPUT_AZOTEQ_IQS5XX
	default y

endif
```

## hardware/integrated-controller/firmware/config/boards/shields/knuckles_tps43/Kconfig.shield
```kconfig
config SHIELD_KNUCKLES_TPS43_LEFT
	def_bool $(shields_list_contains,knuckles_tps43_left)

config SHIELD_KNUCKLES_TPS43_RIGHT
	def_bool $(shields_list_contains,knuckles_tps43_right)
```

## hardware/integrated-controller/firmware/config/west.yml
```yaml
manifest:
  remotes:
    - name: zmkfirmware
      url-base: https://github.com/zmkfirmware
    - name: suchobits
      url-base: https://github.com/suchobits
  projects:
    - name: zmk
      remote: zmkfirmware
      revision: v0.3.0
      import: app/west.yml
    - name: zmk-driver-azoteq-iqs5xx
      remote: suchobits
      revision: e19e55deaf8eeb0d32d9c2fe17e3f87f5287a5a5
  self:
    path: config
```

## hardware/integrated-controller/firmware/dts/bindings/knuckles,power-control.yaml
```yaml
description: Board charging interlock and BQ25186 interrupt
compatible: "knuckles,power-control"
include: base.yaml
properties:
  enable-gpios:
    type: phandle-array
    required: true
  interrupt-gpios:
    type: phandle-array
    required: true
```
