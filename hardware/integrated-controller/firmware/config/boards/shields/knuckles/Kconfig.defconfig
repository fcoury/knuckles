## hardware/integrated-controller/firmware/config/boards/shields/knuckles/Kconfig.defconfig
```kconfig
if SHIELD_KNUCKLES_LEFT

config ZMK_KEYBOARD_NAME
    default "Knuckles"

config ZMK_SPLIT_ROLE_CENTRAL
    default y

endif

if SHIELD_KNUCKLES_LEFT || SHIELD_KNUCKLES_RIGHT

config ZMK_SPLIT
    default y

endif
```
